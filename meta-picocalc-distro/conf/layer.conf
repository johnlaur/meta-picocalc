## meta-picocalc-distro/conf/layer.conf
```bitbake
# We have a conf and classes directory, add to BBPATH
BBPATH .= ":${LAYERDIR}"

# We have recipes-* directories, add to BBFILES
BBFILES += "${LAYERDIR}/recipes-*/*/*.bb \
            ${LAYERDIR}/recipes-*/*/*.bbappend"

BBFILE_COLLECTIONS += "picocalc-core"
BBFILE_PATTERN_picocalc-core = "^${LAYERDIR}/"
BBFILE_PRIORITY_picocalc-core = "99"

# OpenEmbedded compatibility information
# This should only be incremented on significant changes that will
# cause compatibility issues with other layers
LAYERVERSION_picocalc-core = "1"

LAYERSERIES_COMPAT_picocalc-core = "scarthgap walnascar"

PICOCALC_CORE_LAYER_DIR = "${LAYERDIR}"
```
